## conf/layer.conf
```bitbake
BBFILES += " ${LAYERDIR}/recipes-*/*/*/*.bb  ${LAYERDIR}/recipes-*/*/*/*.bbappend"
BBPATH .= ":${LAYERDIR}"
BBFILE_COLLECTIONS += "qti-audio-utils"
BBFILE_PRIORITY_qti-audio-utils = "15"
BBFILE_PATTERN_qti-audio-utils := "^${LAYERDIR}/"
LAYERSERIES_COMPAT_qti-audio-utils = "kirkstone scarthgap"
LAYERVERSION_qti-audio-utils = "1"
```
